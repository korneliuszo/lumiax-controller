## boards/arm/controller/Kconfig.board
```kconfig
# nRF51 BLE400 board configuration

# Copyright (c) 2018 Roman Tataurov <diytronic@yandex.ru>
# SPDX-License-Identifier: Apache-2.0

config BOARD_CONTROLLER
	bool "Controller"
	depends on SOC_NRF51822_QFAC
```

## boards/arm/controller/Kconfig.defconfig
```kconfig
# nRF51 BLE400 board configuration

# Copyright (c) 2018 Roman Tataurov <diytronic@yandex.ru>
# SPDX-License-Identifier: Apache-2.0

if BOARD_CONTROLLER

config BOARD
	default "controller"

config BT_CTLR
	default BT

endif # BOARD_CONTORLLER
```

## boards/arm/controller/dts/bindings/barrot_serial.yaml
```yaml
compatible: "barrot_serial"
description: Barrot

properties:
    btaddr:
      type: uint8-array
      required: true
```
